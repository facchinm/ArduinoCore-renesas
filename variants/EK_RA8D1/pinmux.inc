const uint16_t P000[] = {
PIN_ANALOG|CHANNEL_0|ADC_1|LAST_ITEM_GUARD
};

const uint16_t P001[] = {
PIN_ANALOG|CHANNEL_1|ADC_1|LAST_ITEM_GUARD
};

const uint16_t P002[] = {
PIN_ANALOG|CHANNEL_2|ADC_1|LAST_ITEM_GUARD
};

const uint16_t P003[] = {
PIN_ANALOG|CHANNEL_4|ADC_1|LAST_ITEM_GUARD
};

const uint16_t P004[] = {
PIN_ANALOG|CHANNEL_0|ADC_0|LAST_ITEM_GUARD
};

const uint16_t P005[] = {
PIN_ANALOG|CHANNEL_1|ADC_0|LAST_ITEM_GUARD
};

const uint16_t P006[] = {
PIN_ANALOG|CHANNEL_2|ADC_0|LAST_ITEM_GUARD
};

const uint16_t P007[] = {
PIN_ANALOG|CHANNEL_4|ADC_0|LAST_ITEM_GUARD
};

const uint16_t P008[] = {
PIN_ANALOG|CHANNEL_8|ADC_0|LAST_ITEM_GUARD
};

const uint16_t P009[] = {
PIN_ANALOG|CHANNEL_6|ADC_0|LAST_ITEM_GUARD
};

const uint16_t P010[] = {
PIN_ANALOG|CHANNEL_5|ADC_0,
PIN_INTERRUPT|CHANNEL_14|LAST_ITEM_GUARD
};

const uint16_t P014[] = {
PIN_ANALOG|CHANNEL_7|ADC_0|LAST_ITEM_GUARD
};

const uint16_t P015[] = {
PIN_ANALOG|CHANNEL_5|ADC_1,
PIN_INTERRUPT|CHANNEL_13|LAST_ITEM_GUARD
};

const uint16_t P100[] = {
PIN_PWM|CHANNEL_8|PWM_CHANNEL_B|GPT_ODD_CFG,
PIN_INTERRUPT|CHANNEL_2,
SCI_CHANNEL|PIN_SCK|CHANNEL_9|SCI_ODD_CFG,
PIN_MISO|CHANNEL_1|LAST_ITEM_GUARD
};

const uint16_t P101[] = {
PIN_PWM|CHANNEL_8|PWM_CHANNEL_A|GPT_ODD_CFG,
PIN_INTERRUPT|CHANNEL_1,
SCI_CHANNEL|PIN_RX_MISO_SCL|CHANNEL_9|SCI_ODD_CFG,
PIN_MOSI|CHANNEL_1|LAST_ITEM_GUARD
};

const uint16_t P102[] = {
PIN_PWM|CHANNEL_2|PWM_CHANNEL_B|GPT_ODD_CFG,
SCI_CHANNEL|PIN_TX_MOSI_SDA|CHANNEL_9|SCI_ODD_CFG,
PIN_SCK|CHANNEL_1|LAST_ITEM_GUARD
};

const uint16_t P103[] = {
PIN_PWM|CHANNEL_2|PWM_CHANNEL_A|GPT_ODD_CFG|LAST_ITEM_GUARD
};

const uint16_t P104[] = {
PIN_PWM|CHANNEL_1|PWM_CHANNEL_B|GPT_ODD_CFG,
PIN_INTERRUPT|CHANNEL_1,
SCI_CHANNEL|PIN_CTS_RTS_SS|CHANNEL_9|SCI_ODD_CFG|LAST_ITEM_GUARD
};

const uint16_t P105[] = {
PIN_PWM|CHANNEL_1|PWM_CHANNEL_A|GPT_ODD_CFG,
PIN_INTERRUPT|CHANNEL_0|LAST_ITEM_GUARD
};

const uint16_t P106[] = {
PIN_PWM|CHANNEL_8|PWM_CHANNEL_B|GPT_ODD_CFG|LAST_ITEM_GUARD
};

const uint16_t P107[] = {
PIN_PWM|CHANNEL_8|PWM_CHANNEL_A|GPT_ODD_CFG|LAST_ITEM_GUARD
};

const uint16_t P112[] = {
PIN_PWM|CHANNEL_3|PWM_CHANNEL_B|GPT_ODD_CFG,
SCI_CHANNEL|PIN_TX_MOSI_SDA|CHANNEL_0|SCI_EVEN_CFG|LAST_ITEM_GUARD
};

const uint16_t P113[] = {
PIN_PWM|CHANNEL_2|PWM_CHANNEL_A|GPT_ODD_CFG,
SCI_CHANNEL|PIN_RX_MISO_SCL|CHANNEL_0|SCI_EVEN_CFG|LAST_ITEM_GUARD
};

const uint16_t P114[] = {
PIN_PWM|CHANNEL_2|PWM_CHANNEL_B|GPT_ODD_CFG|LAST_ITEM_GUARD
};

const uint16_t P115[] = {
PIN_PWM|CHANNEL_5|PWM_CHANNEL_A|GPT_ODD_CFG,
SCI_CHANNEL|PIN_CTS_RTS_SS|CHANNEL_0|SCI_EVEN_CFG,
PIN_MOSI|CHANNEL_0|LAST_ITEM_GUARD
};

const uint16_t P206[] = {
PIN_SDA|CHANNEL_1,
SCI_CHANNEL|PIN_RX_MISO_SCL|CHANNEL_4|SCI_EVEN_CFG|LAST_ITEM_GUARD
};

const uint16_t P208[] = {
PIN_PWM|CHANNEL_1|PWM_CHANNEL_B|GPT_ODD_CFG,
PIN_INTERRUPT|CHANNEL_3,
SCI_CHANNEL|PIN_RX_MISO_SCL|CHANNEL_9|SCI_ODD_CFG|LAST_ITEM_GUARD
};

const uint16_t P209[] = {
PIN_PWM|CHANNEL_1|PWM_CHANNEL_A|GPT_ODD_CFG,
SCI_CHANNEL|PIN_TX_MOSI_SDA|CHANNEL_9|SCI_ODD_CFG|LAST_ITEM_GUARD
};

const uint16_t P210[] = {
PIN_PWM|CHANNEL_0|PWM_CHANNEL_B|GPT_ODD_CFG|LAST_ITEM_GUARD
};

const uint16_t P211[] = {
PIN_PWM|CHANNEL_0|PWM_CHANNEL_A|GPT_ODD_CFG,
SCI_CHANNEL|PIN_SCK|CHANNEL_9|SCI_ODD_CFG|LAST_ITEM_GUARD
};

const uint16_t P212[] = {
PIN_PWM|CHANNEL_0|PWM_CHANNEL_B|GPT_ODD_CFG,
PIN_INTERRUPT|CHANNEL_3,
SCI_CHANNEL|PIN_RX_MISO_SCL|CHANNEL_1|SCI_ODD_CFG|LAST_ITEM_GUARD
};

const uint16_t P213[] = {
PIN_PWM|CHANNEL_0|PWM_CHANNEL_A|GPT_ODD_CFG,
PIN_INTERRUPT|CHANNEL_2,
SCI_CHANNEL|PIN_TX_MOSI_SDA|CHANNEL_1|SCI_ODD_CFG|LAST_ITEM_GUARD
};

const uint16_t P300[] = {
PIN_PWM|CHANNEL_3|PWM_CHANNEL_A|GPT_ODD_CFG,
PIN_INTERRUPT|CHANNEL_4,
SCI_CHANNEL|PIN_SCK|CHANNEL_0|SCI_EVEN_CFG|LAST_ITEM_GUARD
};

const uint16_t P301[] = {
PIN_PWM|CHANNEL_4|PWM_CHANNEL_B|GPT_ODD_CFG,
PIN_INTERRUPT|CHANNEL_6|LAST_ITEM_GUARD
};

const uint16_t P302[] = {
PIN_PWM|CHANNEL_4|PWM_CHANNEL_A|GPT_ODD_CFG,
PIN_INTERRUPT|CHANNEL_5|LAST_ITEM_GUARD
};

const uint16_t P303[] = {
PIN_PWM|CHANNEL_7|PWM_CHANNEL_B|GPT_ODD_CFG|LAST_ITEM_GUARD
};

const uint16_t P304[] = {
PIN_PWM|CHANNEL_7|PWM_CHANNEL_A|GPT_ODD_CFG,
PIN_INTERRUPT|CHANNEL_9|LAST_ITEM_GUARD
};

const uint16_t P305[] = {
PIN_INTERRUPT|CHANNEL_8|LAST_ITEM_GUARD
};

const uint16_t P308[] = {
SCI_CHANNEL|PIN_CTS_RTS_SS|CHANNEL_9|SCI_ODD_CFG|LAST_ITEM_GUARD
};

const uint16_t P309[] = {
SCI_CHANNEL|PIN_RX_MISO_SCL|CHANNEL_3|SCI_ODD_CFG|LAST_ITEM_GUARD
};

const uint16_t P310[] = {
SCI_CHANNEL|PIN_TX_MOSI_SDA|CHANNEL_3|SCI_ODD_CFG|LAST_ITEM_GUARD
};

const uint16_t P311[] = {
SCI_CHANNEL|PIN_SCK|CHANNEL_3|SCI_ODD_CFG|LAST_ITEM_GUARD
};

const uint16_t P400[] = {
PIN_PWM|CHANNEL_6|PWM_CHANNEL_A|GPT_ODD_CFG,
PIN_INTERRUPT|CHANNEL_0,
SCI_CHANNEL|PIN_TX_MOSI_SDA|CHANNEL_1|SCI_ODD_CFG|LAST_ITEM_GUARD
};

const uint16_t P401[] = {
PIN_PWM|CHANNEL_6|PWM_CHANNEL_B|GPT_ODD_CFG,
SCI_CHANNEL|PIN_RX_MISO_SCL|CHANNEL_1|SCI_ODD_CFG|LAST_ITEM_GUARD
};

const uint16_t P402[] = {
SCI_CHANNEL|PIN_SCK|CHANNEL_1|SCI_ODD_CFG|LAST_ITEM_GUARD
};

const uint16_t P403[] = {
PIN_PWM|CHANNEL_3|PWM_CHANNEL_A|GPT_ODD_CFG|LAST_ITEM_GUARD
};

const uint16_t P404[] = {
PIN_PWM|CHANNEL_3|PWM_CHANNEL_B|GPT_ODD_CFG,
SCI_CHANNEL|PIN_CTS_RTS_SS|CHANNEL_1|SCI_ODD_CFG|LAST_ITEM_GUARD
};

const uint16_t P405[] = {
PIN_PWM|CHANNEL_1|PWM_CHANNEL_A|GPT_ODD_CFG,
SCI_CHANNEL|PIN_SCK|CHANNEL_2|SCI_EVEN_CFG|LAST_ITEM_GUARD
};

const uint16_t P406[] = {
PIN_PWM|CHANNEL_1|PWM_CHANNEL_B|GPT_ODD_CFG,
SCI_CHANNEL|PIN_TX_MOSI_SDA|CHANNEL_2|SCI_EVEN_CFG|LAST_ITEM_GUARD
};

const uint16_t P407[] = {
PIN_PWM|CHANNEL_10|PWM_CHANNEL_B|GPT_ODD_CFG,
PIN_SDA|CHANNEL_0|LAST_ITEM_GUARD
};

const uint16_t P408[] = {
PIN_PWM|CHANNEL_10|PWM_CHANNEL_A|GPT_ODD_CFG,
PIN_SCL|CHANNEL_0,
PIN_INTERRUPT|CHANNEL_7,
SCI_CHANNEL|PIN_RX_MISO_SCL|CHANNEL_3|SCI_ODD_CFG,
SCI_CHANNEL|PIN_CTS_RTS_SS|CHANNEL_4|SCI_EVEN_CFG|LAST_ITEM_GUARD
};

const uint16_t P409[] = {
PIN_SDA|CHANNEL_0,
PIN_INTERRUPT|CHANNEL_6,
SCI_CHANNEL|PIN_TX_MOSI_SDA|CHANNEL_3|SCI_ODD_CFG|LAST_ITEM_GUARD
};

const uint16_t P410[] = {
PIN_PWM|CHANNEL_9|PWM_CHANNEL_B|GPT_ODD_CFG,
PIN_SCL|CHANNEL_0,
PIN_INTERRUPT|CHANNEL_5,
SCI_CHANNEL|PIN_SCK|CHANNEL_3|SCI_ODD_CFG,
PIN_MISO|CHANNEL_1|LAST_ITEM_GUARD
};

const uint16_t P411[] = {
PIN_PWM|CHANNEL_9|PWM_CHANNEL_A|GPT_ODD_CFG,
PIN_INTERRUPT|CHANNEL_4,
PIN_MOSI|CHANNEL_1|LAST_ITEM_GUARD
};

const uint16_t P412[] = {
SCI_CHANNEL|PIN_CTS_RTS_SS|CHANNEL_3|SCI_ODD_CFG,
PIN_SCK|CHANNEL_1|LAST_ITEM_GUARD
};

const uint16_t P414[] = {
PIN_PWM|CHANNEL_0|PWM_CHANNEL_B|GPT_ODD_CFG,
PIN_INTERRUPT|CHANNEL_9,
SCI_CHANNEL|PIN_RX_MISO_SCL|CHANNEL_4|SCI_EVEN_CFG|LAST_ITEM_GUARD
};

const uint16_t P415[] = {
PIN_PWM|CHANNEL_0|PWM_CHANNEL_A|GPT_ODD_CFG,
PIN_INTERRUPT|CHANNEL_8,
SCI_CHANNEL|PIN_TX_MOSI_SDA|CHANNEL_4|SCI_EVEN_CFG|LAST_ITEM_GUARD
};

const uint16_t P500[] = {
PIN_ANALOG|CHANNEL_21|ADC_1|LAST_ITEM_GUARD
};

const uint16_t P501[] = {
PIN_ANALOG|CHANNEL_20|ADC_1|LAST_ITEM_GUARD
};

const uint16_t P502[] = {
PIN_ANALOG|CHANNEL_19|ADC_0,
PIN_ANALOG|CHANNEL_19|ADC_1|LAST_ITEM_GUARD
};

const uint16_t P511[] = {
PIN_PWM|CHANNEL_0|PWM_CHANNEL_B|GPT_ODD_CFG,
PIN_SDA|CHANNEL_1,
PIN_INTERRUPT|CHANNEL_15|LAST_ITEM_GUARD
};

const uint16_t P512[] = {
PIN_PWM|CHANNEL_0|PWM_CHANNEL_A|GPT_ODD_CFG,
PIN_SCL|CHANNEL_1,
PIN_INTERRUPT|CHANNEL_14|LAST_ITEM_GUARD
};

const uint16_t P513[] = {
PIN_ANALOG|CHANNEL_16|ADC_0,
PIN_ANALOG|CHANNEL_16|ADC_1|LAST_ITEM_GUARD
};

const uint16_t P600[] = {
PIN_PWM|CHANNEL_6|PWM_CHANNEL_B|GPT_ODD_CFG|LAST_ITEM_GUARD
};

const uint16_t P601[] = {
PIN_PWM|CHANNEL_6|PWM_CHANNEL_A|GPT_ODD_CFG,
SCI_CHANNEL|PIN_SCK|CHANNEL_0|SCI_EVEN_CFG|LAST_ITEM_GUARD
};

const uint16_t P602[] = {
PIN_PWM|CHANNEL_7|PWM_CHANNEL_B|GPT_ODD_CFG,
SCI_CHANNEL|PIN_RX_MISO_SCL|CHANNEL_0|SCI_EVEN_CFG|LAST_ITEM_GUARD
};

const uint16_t P603[] = {
PIN_PWM|CHANNEL_7|PWM_CHANNEL_A|GPT_ODD_CFG,
SCI_CHANNEL|PIN_TX_MOSI_SDA|CHANNEL_0|SCI_EVEN_CFG|LAST_ITEM_GUARD
};

const uint16_t P604[] = {
PIN_PWM|CHANNEL_8|PWM_CHANNEL_B|GPT_ODD_CFG|LAST_ITEM_GUARD
};

const uint16_t P605[] = {
PIN_PWM|CHANNEL_8|PWM_CHANNEL_A|GPT_ODD_CFG,
SCI_CHANNEL|PIN_CTS_RTS_SS|CHANNEL_0|SCI_EVEN_CFG|LAST_ITEM_GUARD
};

const uint16_t P609[] = {
PIN_PWM|CHANNEL_5|PWM_CHANNEL_B|GPT_ODD_CFG,
SCI_CHANNEL|PIN_TX_MOSI_SDA|CHANNEL_0|SCI_EVEN_CFG,
PIN_MISO|CHANNEL_0|LAST_ITEM_GUARD
};

const uint16_t P610[] = {
PIN_PWM|CHANNEL_4|PWM_CHANNEL_A|GPT_ODD_CFG,
SCI_CHANNEL|PIN_RX_MISO_SCL|CHANNEL_0|SCI_EVEN_CFG,
PIN_SCK|CHANNEL_0|LAST_ITEM_GUARD
};

const uint16_t P611[] = {
PIN_PWM|CHANNEL_4|PWM_CHANNEL_B|GPT_ODD_CFG,
SCI_CHANNEL|PIN_SCK|CHANNEL_0|SCI_EVEN_CFG,
PIN_MOSI|CHANNEL_0|LAST_ITEM_GUARD
};

const uint16_t P613[] = {
SCI_CHANNEL|PIN_CTS_RTS_SS|CHANNEL_0|SCI_EVEN_CFG|LAST_ITEM_GUARD
};

const uint16_t P615[] = {
PIN_INTERRUPT|CHANNEL_7|LAST_ITEM_GUARD
};

const uint16_t P700[] = {
PIN_PWM|CHANNEL_5|PWM_CHANNEL_A|GPT_ODD_CFG,
SCI_CHANNEL|PIN_RX_MISO_SCL|CHANNEL_2|SCI_EVEN_CFG,
PIN_MISO|CHANNEL_0|LAST_ITEM_GUARD
};

const uint16_t P701[] = {
PIN_PWM|CHANNEL_5|PWM_CHANNEL_B|GPT_ODD_CFG,
PIN_MOSI|CHANNEL_0|LAST_ITEM_GUARD
};

const uint16_t P702[] = {
PIN_PWM|CHANNEL_6|PWM_CHANNEL_A|GPT_ODD_CFG,
SCI_CHANNEL|PIN_CTS_RTS_SS|CHANNEL_2|SCI_EVEN_CFG,
PIN_SCK|CHANNEL_0|LAST_ITEM_GUARD
};

const uint16_t P703[] = {
PIN_PWM|CHANNEL_6|PWM_CHANNEL_B|GPT_ODD_CFG|LAST_ITEM_GUARD
};

const uint16_t P705[] = {
SCI_CHANNEL|PIN_CTS_RTS_SS|CHANNEL_1|SCI_ODD_CFG|LAST_ITEM_GUARD
};

const uint16_t P706[] = {
PIN_INTERRUPT|CHANNEL_7,
SCI_CHANNEL|PIN_RX_MISO_SCL|CHANNEL_1|SCI_ODD_CFG|LAST_ITEM_GUARD
};

const uint16_t P707[] = {
PIN_INTERRUPT|CHANNEL_8,
SCI_CHANNEL|PIN_TX_MOSI_SDA|CHANNEL_1|SCI_ODD_CFG|LAST_ITEM_GUARD
};

const uint16_t P708[] = {
PIN_INTERRUPT|CHANNEL_11,
SCI_CHANNEL|PIN_SCK|CHANNEL_4|SCI_EVEN_CFG|LAST_ITEM_GUARD
};

const uint16_t P709[] = {
PIN_INTERRUPT|CHANNEL_10|LAST_ITEM_GUARD
};

const uint16_t P710[] = {
SCI_CHANNEL|PIN_CTS_RTS_SS|CHANNEL_4|SCI_EVEN_CFG|LAST_ITEM_GUARD
};

const uint16_t P800[] = {
PIN_PWM|CHANNEL_11|PWM_CHANNEL_A|GPT_ODD_CFG,
PIN_INTERRUPT|CHANNEL_11,
SCI_CHANNEL|PIN_CTS_RTS_SS|CHANNEL_2|SCI_EVEN_CFG|LAST_ITEM_GUARD
};

const uint16_t P801[] = {
PIN_PWM|CHANNEL_11|PWM_CHANNEL_B|GPT_ODD_CFG,
PIN_INTERRUPT|CHANNEL_12,
SCI_CHANNEL|PIN_TX_MOSI_SDA|CHANNEL_2|SCI_EVEN_CFG|LAST_ITEM_GUARD
};

const uint16_t P802[] = {
PIN_PWM|CHANNEL_12|PWM_CHANNEL_A|GPT_ODD_CFG,
SCI_CHANNEL|PIN_RX_MISO_SCL|CHANNEL_2|SCI_EVEN_CFG|LAST_ITEM_GUARD
};

const uint16_t P803[] = {
PIN_PWM|CHANNEL_12|PWM_CHANNEL_B|GPT_ODD_CFG,
SCI_CHANNEL|PIN_SCK|CHANNEL_2|SCI_EVEN_CFG|LAST_ITEM_GUARD
};

const uint16_t P804[] = {
PIN_PWM|CHANNEL_13|PWM_CHANNEL_A|GPT_ODD_CFG,
PIN_INTERRUPT|CHANNEL_14|LAST_ITEM_GUARD
};

const uint16_t P805[] = {
PIN_ANALOG|CHANNEL_17|ADC_0,
PIN_ANALOG|CHANNEL_17|ADC_1|LAST_ITEM_GUARD
};

const uint16_t P806[] = {
PIN_ANALOG|CHANNEL_18|ADC_0,
PIN_ANALOG|CHANNEL_18|ADC_1,
PIN_INTERRUPT|CHANNEL_0|LAST_ITEM_GUARD
};

const uint16_t P808[] = {
PIN_PWM|CHANNEL_13|PWM_CHANNEL_B|GPT_ODD_CFG,
PIN_INTERRUPT|CHANNEL_15|LAST_ITEM_GUARD
};

const uint16_t P812[] = {
PIN_ANALOG|CHANNEL_22|ADC_1|LAST_ITEM_GUARD
};

const uint16_t P814[] = {
PIN_PWM|CHANNEL_8|PWM_CHANNEL_B|GPT_ODD_CFG|LAST_ITEM_GUARD
};

const uint16_t P815[] = {
PIN_PWM|CHANNEL_8|PWM_CHANNEL_A|GPT_ODD_CFG|LAST_ITEM_GUARD
};

const uint16_t P905[] = {
PIN_INTERRUPT|CHANNEL_8,
SCI_CHANNEL|PIN_CTS_RTS_SS|CHANNEL_3|SCI_ODD_CFG|LAST_ITEM_GUARD
};

const uint16_t P906[] = {
PIN_PWM|CHANNEL_13|PWM_CHANNEL_B|GPT_ODD_CFG,
PIN_INTERRUPT|CHANNEL_9|LAST_ITEM_GUARD
};

const uint16_t P907[] = {
PIN_PWM|CHANNEL_13|PWM_CHANNEL_A|GPT_ODD_CFG,
PIN_INTERRUPT|CHANNEL_10|LAST_ITEM_GUARD
};

const uint16_t P908[] = {
PIN_PWM|CHANNEL_12|PWM_CHANNEL_B|GPT_ODD_CFG,
PIN_INTERRUPT|CHANNEL_11|LAST_ITEM_GUARD
};

const uint16_t P909[] = {
PIN_PWM|CHANNEL_12|PWM_CHANNEL_A|GPT_ODD_CFG|LAST_ITEM_GUARD
};

const uint16_t PA08[] = {
PIN_INTERRUPT|CHANNEL_6|LAST_ITEM_GUARD
};

const uint16_t PA09[] = {
PIN_INTERRUPT|CHANNEL_5|LAST_ITEM_GUARD
};

const uint16_t PA10[] = {
PIN_INTERRUPT|CHANNEL_4|LAST_ITEM_GUARD
};

const uint16_t PB00[] = {
SCI_CHANNEL|PIN_SCK|CHANNEL_1|SCI_ODD_CFG|LAST_ITEM_GUARD
};

